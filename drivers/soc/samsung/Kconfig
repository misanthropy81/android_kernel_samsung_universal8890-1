## drivers/soc/samsung/Kconfig
```kconfig
#
# EXYNOS Soc drivers
#
menuconfig SOC_SAMSUNG
	bool "SAMSUNG SOC drivers support"

if SOC_SAMSUNG
config EXYNOS_CHIPID
	bool "Exynos Chip ID Driver Support"
	depends on ARCH_EXYNOS
	select SOC_BUS
config EXYNOS_REBOOT
	bool "Exynos Chip Reboot Driver Support"
	depends on ARCH_EXYNOS

config SAMSUNG_DMADEV
	bool
	select ARM_AMBA
	select DMADEVICES
	select PL330_DMA if (ARCH_EXYNOS8)
	help
	  Use DMA device engine for PL330 DMAC.

config ECT
	bool "Enable Exynos Characteristic Table File"
	default n
	depends on ARCH_EXYNOS

config ECT_DUMP
	bool "Enable Exynos Characteristic Table File Dump sysfs"
	default n
	depends on ECT

config EXYNOS_CONTENT_PATH_PROTECTION
	bool "Exynos Content Path Protection"
	default y
	help
	  Enable content path protection of EXYNOS.

config EXYNOS_PM_DVS
	bool "Enable Exynos dynamic voltage setting"
	default n

config EXYNOS_OTP
	bool "Exynos OTP (one-time programmable) support"
	default n
	depends on ARCH_EXYNOS
	help
		This option enables OTP (one-time programmable) tune bits functions

endif #SOC_SAMSUNG
```
